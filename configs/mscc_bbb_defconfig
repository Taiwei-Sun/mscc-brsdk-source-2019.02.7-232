## configs/mscc_bbb_defconfig
```kconfig
BR2_arm=y
BR2_cortex_a8=y
BR2_TOOLCHAIN_EXTERNAL=y
BR2_TOOLCHAIN_EXTERNAL_CUSTOM=y
BR2_TOOLCHAIN_EXTERNAL_PATH="/opt/mscc/mscc-toolchain-bin-2019.02.7-082/arm-cortex_a8-linux-gnueabihf"
BR2_TOOLCHAIN_EXTERNAL_CUSTOM_GLIBC=y
BR2_TOOLCHAIN_EXTERNAL_HEADERS_4_19=y
BR2_TOOLCHAIN_EXTERNAL_GCC_8=y
BR2_PRIMARY_SITE="http://soft02.microsemi.net/mirror"
BR2_LINUX_KERNEL=y
BR2_LINUX_KERNEL_CUSTOM_TARBALL=y
BR2_LINUX_KERNEL_CUSTOM_TARBALL_LOCATION="http://git-ent.microsemi.net/sw/linux/archive/6f193c03ead8b052dee09edbdb6ccae9a1f136ca.tar.gz"
BR2_LINUX_KERNEL_USE_CUSTOM_CONFIG=y
BR2_LINUX_KERNEL_CUSTOM_CONFIG_FILE="board/beaglebone/bbb_kernel.config"
BR2_LINUX_KERNEL_DTS_SUPPORT=y
BR2_LINUX_KERNEL_INTREE_DTS_NAME="am335x-evm am335x-bone am335x-boneblack am335x-bonegreen am335x-evmsk am335x-boneblack-mscc"

BR2_TARGET_UBOOT=y
BR2_TARGET_UBOOT_BUILD_SYSTEM_KCONFIG=y
BR2_TARGET_UBOOT_CUSTOM_VERSION=y
BR2_TARGET_UBOOT_CUSTOM_VERSION_VALUE="2018.09"
BR2_TARGET_UBOOT_BOARD_DEFCONFIG="am335x_evm"
BR2_TARGET_UBOOT_NEEDS_DTC=y
# BR2_TARGET_UBOOT_FORMAT_BIN is not set
BR2_TARGET_UBOOT_FORMAT_IMG=y
BR2_TARGET_UBOOT_SPL=y
BR2_TARGET_UBOOT_SPL_NAME="MLO"

BR2_PACKAGE_HOST_GDB=y
BR2_TARGET_GENERIC_ISSUE="Welcome to BeagleBoneBlack/MESA SDK"
BR2_TARGET_GENERIC_GETTY_PORT="ttyO0"
BR2_ROOTFS_OVERLAY="board/vtss/beaglebone/rootfs_overlay_stage2"
BR2_ROOTFS_POST_IMAGE_SCRIPT="board/beaglebone/gen-image.rb"
BR2_PACKAGE_BUSYBOX_SHOW_OTHERS=y
BR2_PACKAGE_XZ_EMBEDDED=y
BR2_PACKAGE_MTD=y
BR2_PACKAGE_IF_MUX=y
BR2_PACKAGE_IF_MUX_TYPE_OCELOT=y
BR2_PACKAGE_JSON_C=y
BR2_PACKAGE_LIBFCGI=y
BR2_PACKAGE_LIBNET=y
BR2_PACKAGE_LIBUPNP=y
BR2_PACKAGE_DHCP=y
BR2_PACKAGE_DHCP_RELAY=y
BR2_PACKAGE_DROPBEAR=y
# BR2_PACKAGE_DROPBEAR_CLIENT is not set
BR2_PACKAGE_HIAWATHA=y
BR2_PACKAGE_HIAWATHA_SSL=y
BR2_PACKAGE_HIAWATHA_TOOLKIT=y
BR2_PACKAGE_IPROUTE2=y
BR2_PACKAGE_IPTABLES=y
BR2_PACKAGE_NETSNMP=y
# BR2_PACKAGE_NETSNMP_CLIENTS is not set
# BR2_PACKAGE_NETSNMP_ENABLE_MIBS is not set
BR2_PACKAGE_NETSNMP_WITH_MIB_MODULES="agentx mibII/vacm_vars mibII/vacm_conf mibII/snmp_mib snmpv3mibs"
BR2_PACKAGE_NETSNMP_WITHOUT_MIB_MODULES="disman/event disman/schedule utilities default_modules"
BR2_PACKAGE_NETSNMP_OPENSSL_INTERNAL=y
BR2_PACKAGE_NTP=y
BR2_PACKAGE_PUTTY=y
BR2_TARGET_ROOTFS_EXT2=y
BR2_TARGET_ROOTFS_EXT2_4=y
BR2_PACKAGE_HOST_DOSFSTOOLS=y
BR2_PACKAGE_HOST_GENIMAGE=y
BR2_PACKAGE_HOST_MTOOLS=y
BR2_PACKAGE_HOST_SQUASHFS=y
BR2_PACKAGE_HOST_UBOOT_TOOLS=y
BR2_PACKAGE_HOST_UBOOT_TOOLS_FIT_SUPPORT=y
BR2_PACKAGE_UBOOT_TOOLS=y
```

## configs/mscc_ls1046_defconfig
```kconfig
BR2_aarch64=y
BR2_cortex_a53=y
BR2_TOOLCHAIN_EXTERNAL=y
BR2_TOOLCHAIN_EXTERNAL_CUSTOM=y
BR2_TOOLCHAIN_EXTERNAL_PATH="/opt/mscc/mscc-toolchain-bin-2019.02.7-082/arm64-armv8_a-linux-gnu"
BR2_TOOLCHAIN_EXTERNAL_CUSTOM_GLIBC=y
BR2_TOOLCHAIN_EXTERNAL_HEADERS_4_19=y
BR2_TOOLCHAIN_EXTERNAL_GCC_8=y
BR2_TOOLCHAIN_EXTERNAL_CXX=y
BR2_PRIMARY_SITE="http://soft02.microsemi.net/mirror"
BR2_LINUX_KERNEL=y
BR2_LINUX_KERNEL_CUSTOM_TARBALL=y
BR2_LINUX_KERNEL_CUSTOM_TARBALL_LOCATION="http://git-ent.microsemi.net/sw/linux/archive/6f193c03ead8b052dee09edbdb6ccae9a1f136ca.tar.gz"
BR2_LINUX_KERNEL_USE_CUSTOM_CONFIG=y
BR2_LINUX_KERNEL_CUSTOM_CONFIG_FILE="board/ls1046/ls1046_kernel.config"
BR2_LINUX_KERNEL_DTS_SUPPORT=y
BR2_LINUX_KERNEL_INTREE_DTS_NAME="freescale/fsl-ls1046a-miriac-sbc1046 freescale/mscc-ls1046a-jaguar2-pcb110"

BR2_PACKAGE_HOST_UBOOT_TOOLS=y
BR2_PACKAGE_HOST_UBOOT_TOOLS_FIT_SUPPORT=y
BR2_PACKAGE_HOST_UBOOT_TOOLS_FIT_SIGNATURE_SUPPORT=y
BR2_TARGET_GENERIC_HOSTNAME="vcoreiii"
BR2_TARGET_GENERIC_ISSUE="Welcome to SMBStaX"
BR2_ROOTFS_OVERLAY="board/vtss/common/rootfs_overlay"
BR2_PACKAGE_XZ_EMBEDDED=y
BR2_PACKAGE_MTD=y
BR2_PACKAGE_UBOOT_TOOLS=y
BR2_PACKAGE_CURL=y
BR2_PACKAGE_LIBCURL=y
BR2_PACKAGE_LIBCURL_VERBOSE=y
BR2_PACKAGE_LIBSSH2=y
BR2_PACKAGE_BUSYBOX_CONFIG_FRAGMENT_FILES="package/busybox/mscc_fragment.config"
BR2_PACKAGE_BUSYBOX_SHOW_OTHERS=y
BR2_PACKAGE_JSON_C=y
BR2_PACKAGE_LIBFCGI=y
BR2_PACKAGE_LIBNET=y
BR2_PACKAGE_LIBUPNP=y
BR2_PACKAGE_DROPBEAR=y
BR2_PACKAGE_DHCP=y
BR2_PACKAGE_DHCP_RELAY=y
# BR2_PACKAGE_DROPBEAR_CLIENT is not set
BR2_PACKAGE_HIAWATHA=y
BR2_PACKAGE_HIAWATHA_SSL=y
BR2_PACKAGE_HIAWATHA_TOOLKIT=y
BR2_PACKAGE_IPTABLES=y
BR2_PACKAGE_NETSNMP=y
# BR2_PACKAGE_NETSNMP_CLIENTS is not set
# BR2_PACKAGE_NETSNMP_ENABLE_MIBS is not set
BR2_PACKAGE_NETSNMP_WITH_MIB_MODULES="agentx mibII/vacm_vars mibII/vacm_conf mibII/snmp_mib snmpv3mibs"
BR2_PACKAGE_NETSNMP_WITHOUT_MIB_MODULES="disman/event disman/schedule utilities default_modules"
BR2_PACKAGE_NETSNMP_OPENSSL_INTERNAL=y
BR2_PACKAGE_NTP=y
BR2_TARGET_ROOTFS_SQUASHFS=y
BR2_TARGET_ROOTFS_SQUASHFS4_XZ=y
```

## configs/mscc_stage1_luton26_defconfig
```kconfig
BR2_mipsel=y
BR2_mips_32r2=y
BR2_STATIC_LIBS=y
BR2_INIT_NONE=y
BR2_TARGET_GENERIC_HOSTNAME="vcoreiii"
BR2_TARGET_GENERIC_ISSUE="Welcome to SMBStaX"
# BR2_PACKAGE_BUSYBOX is not set
# BR2_TARGET_GENERIC_GETTY is not set
BR2_SYSTEM_BIN_SH_NONE=y
BR2_PACKAGE_MSCC_MODULAR_FIRMWARE=y
BR2_TARGET_ROOTFS_SQUASHFS=y
BR2_TARGET_ROOTFS_SQUASHFS4_XZ=y
BR2_TOOLCHAIN_EXTERNAL=y
BR2_TOOLCHAIN_EXTERNAL_CUSTOM=y
BR2_TOOLCHAIN_EXTERNAL_PATH="/opt/mscc/mscc-toolchain-bin-2019.02.7-082/mipsel-mips32r2-linux-uclibc"
BR2_TOOLCHAIN_EXTERNAL_HEADERS_4_19=y
BR2_TOOLCHAIN_EXTERNAL_GCC_8=y
# BR2_TOOLCHAIN_EXTERNAL_HAS_THREADS_DEBUG is not set
BR2_TARGET_UBOOT=y
BR2_TARGET_UBOOT_BUILD_SYSTEM_KCONFIG=y
BR2_TARGET_UBOOT_CUSTOM_TARBALL=y
BR2_TARGET_UBOOT_CUSTOM_TARBALL_LOCATION="http://git-ent.microsemi.net/sw/uboot/archive/d7973cd01b22e15be6e4a912fe445ab19d09d335.tar.gz"
BR2_TARGET_UBOOT_USE_CUSTOM_CONFIG=y
BR2_LINUX_KERNEL_CUSTOM_CONFIG_FILE="board/luton26/luton26_kernel.config"
BR2_TARGET_UBOOT_CUSTOM_CONFIG_FILE="board/luton26/luton26_uboot.config"
BR2_ROOTFS_POST_IMAGE_SCRIPT="board/mscc/rename-sign-uboot.rb"
BR2_ROOTFS_POST_SCRIPT_ARGS="mscc_stage1_luton26_defconfig/images/u-boot.bin mscc_stage1_luton26_defconfig/images luton26"
BR2_LINUX_KERNEL=y
BR2_LINUX_KERNEL_CUSTOM_TARBALL=y
BR2_LINUX_KERNEL_CUSTOM_TARBALL_LOCATION="http://git-ent.microsemi.net/sw/linux/archive/6f193c03ead8b052dee09edbdb6ccae9a1f136ca.tar.gz"
BR2_LINUX_KERNEL_USE_CUSTOM_CONFIG=y
BR2_LINUX_KERNEL_VMLINUX_BIN=y
BR2_LINUX_KERNEL_XZ=y
BR2_PRIMARY_SITE="http://soft02.microsemi.net/mirror"
```

## configs/mscc_stage2_debug_defconfig
```kconfig
BR2_mipsel=y
BR2_mips_32r2=y
BR2_TARGET_GENERIC_HOSTNAME="vcoreiii"
BR2_TARGET_GENERIC_ISSUE="Welcome to SMBStaX"
BR2_ROOTFS_OVERLAY="board/vtss/common/rootfs_overlay"
BR2_PACKAGE_XZ_EMBEDDED=y
BR2_PACKAGE_MTD=y
BR2_PACKAGE_UBOOT_TOOLS=y
BR2_PACKAGE_CURL=y
BR2_PACKAGE_LIBCURL=y
BR2_PACKAGE_LIBCURL_VERBOSE=y
BR2_PACKAGE_LIBSSH2=y
BR2_TOOLCHAIN_EXTERNAL=y
BR2_TOOLCHAIN_EXTERNAL_CUSTOM=y
BR2_TOOLCHAIN_EXTERNAL_PATH="/opt/mscc/mscc-toolchain-bin-2019.02.7-082/mipsel-mips32r2-linux-gnu"
BR2_TOOLCHAIN_EXTERNAL_CUSTOM_GLIBC=y
BR2_TOOLCHAIN_EXTERNAL_HEADERS_4_19=y
BR2_TOOLCHAIN_EXTERNAL_GCC_8=y
BR2_TOOLCHAIN_EXTERNAL_CXX=y
BR2_PRIMARY_SITE="http://soft02.microsemi.net/mirror"
BR2_PACKAGE_BUSYBOX_CONFIG_FRAGMENT_FILES="package/busybox/mscc_fragment.config"
BR2_ENABLE_DEBUG=y
BR2_SSP_REGULAR=y
BR2_PACKAGE_HOST_GDB=y
BR2_GDB_VERSION_7_12=y
BR2_PACKAGE_GDB=y
BR2_PACKAGE_STRACE=y
BR2_PACKAGE_JSON_C=y
BR2_PACKAGE_LIBFCGI=y
BR2_PACKAGE_LIBNET=y
BR2_PACKAGE_LIBUPNP=y
BR2_PACKAGE_LIBUNWIND=y
BR2_PACKAGE_DROPBEAR=y
BR2_PACKAGE_HIAWATHA=y
BR2_PACKAGE_HIAWATHA_SSL=y
BR2_PACKAGE_HIAWATHA_TOOLKIT=y
BR2_PACKAGE_IPROUTE2=y
BR2_PACKAGE_IPTABLES=y
BR2_PACKAGE_NETSNMP=y
BR2_PACKAGE_NETSNMP_WITH_MIB_MODULES="agentx mibII/vacm_vars mibII/vacm_conf mibII/snmp_mib snmpv3mibs"
BR2_PACKAGE_NETSNMP_WITHOUT_MIB_MODULES="disman/event disman/schedule utilities default_modules"
BR2_PACKAGE_NETSNMP_OPENSSL_INTERNAL=y
BR2_PACKAGE_NTP=y
BR2_TARGET_ROOTFS_SQUASHFS=y
BR2_TARGET_ROOTFS_SQUASHFS4_XZ=y
BR2_PACKAGE_DHCP=y
BR2_PACKAGE_BUSYBOX_SHOW_OTHERS=y
BR2_PACKAGE_HOST_UBOOT_TOOLS=y
BR2_PACKAGE_HOST_UBOOT_TOOLS_FIT_SUPPORT=y
```

## configs/mscc_stage2_minimal_defconfig
```kconfig
BR2_mipsel=y
BR2_mips_32r2=y
BR2_TARGET_GENERIC_HOSTNAME="vcoreiii"
BR2_TARGET_GENERIC_ISSUE="Welcome to SMBStaX"
BR2_ROOTFS_OVERLAY="board/vtss/common/rootfs_overlay"
BR2_PACKAGE_XZ_EMBEDDED=y
BR2_PACKAGE_MTD=y
BR2_PACKAGE_UBOOT_TOOLS=y
BR2_PACKAGE_CURL=y
BR2_PACKAGE_LIBCURL=y
BR2_PACKAGE_LIBCURL_VERBOSE=y
BR2_PACKAGE_LIBSSH2=y
BR2_TOOLCHAIN_EXTERNAL=y
BR2_TOOLCHAIN_EXTERNAL_CUSTOM=y
BR2_TOOLCHAIN_EXTERNAL_PATH="/opt/mscc/mscc-toolchain-bin-2019.02.7-082/mipsel-mips32r2-linux-gnu"
BR2_TOOLCHAIN_EXTERNAL_CUSTOM_GLIBC=y
BR2_TOOLCHAIN_EXTERNAL_HEADERS_4_19=y
BR2_TOOLCHAIN_EXTERNAL_GCC_8=y
BR2_TOOLCHAIN_EXTERNAL_CXX=y
BR2_PRIMARY_SITE="http://soft02.microsemi.net/mirror"
BR2_PACKAGE_BUSYBOX_CONFIG_FRAGMENT_FILES="package/busybox/mscc_fragment.config"
BR2_PACKAGE_ZLIB=y
BR2_PACKAGE_MBEDTLS=y
BR2_PACKAGE_DROPBEAR=y
BR2_TARGET_ROOTFS_SQUASHFS=y
BR2_TARGET_ROOTFS_SQUASHFS4_XZ=y
# BR2_PACKAGE_MTD_FLASH_LOCK is not set
# BR2_PACKAGE_MTD_FLASH_UNLOCK is not set
BR2_PACKAGE_HOST_UBOOT_TOOLS=y
BR2_PACKAGE_HOST_UBOOT_TOOLS_FIT_SUPPORT=y
```

## package/if_mux/Config.in
```kconfig
config BR2_PACKAGE_IF_MUX
	bool "if-mux"
	depends on BR2_LINUX_KERNEL
	help
	  Kernel module for if_mux

          If_mux is a Linux kernel module for the MSCC Ethernet switch
          virtual mux driver.

	  Make sure your target kernel has the following config
	  options enabled:

	    * CONFIG_MODULES: loadable module support

comment "if-mux needs a Linux kernel to be built"
	depends on !BR2_LINUX_KERNEL

if BR2_PACKAGE_IF_MUX
choice
        prompt "Switch type"

config BR2_PACKAGE_IF_MUX_TYPE_CARACAL
        bool "Caracal-1/2, Luton-26"

config BR2_PACKAGE_IF_MUX_TYPE_SERVAL1
        bool "Serval-1"

config BR2_PACKAGE_IF_MUX_TYPE_OCELOT
        bool "Ocelot"

config BR2_PACKAGE_IF_MUX_TYPE_JAGUAR2C
        bool "Jaguar-2 (Serval-2, Jaguar-2-24, Jaguar-2-48)"

config BR2_PACKAGE_IF_MUX_TYPE_SERVALT
        bool "Serval-T"

endchoice
endif
```

## package/mscc-modular-firmware/Config.in
```kconfig
config BR2_PACKAGE_MSCC_MODULAR_FIRMWARE
	bool "mscc-modular-firmware"
	select BR2_STATIC_LIBS
	select BR2_PACKAGE_ZLIB
	select BR2_PACKAGE_MBEDTLS
	help
	  Executable for loading mscc-firmware
```

## package/xz-embedded/Config.in
```kconfig
config BR2_PACKAGE_XZ_EMBEDDED
	bool "xz-embedded"
	help
          XZ Embedded is a relatively small decompressor for the .xz
          file format. It was developed with the Linux kernel in mind,
          but it is easily usable in other projects too.

	  http://tukaani.org/xz/embedded.html
```
